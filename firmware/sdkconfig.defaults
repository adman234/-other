## firmware/sdkconfig.defaults
```kconfig
CONFIG_IDF_TARGET="esp32"
CONFIG_ESPTOOLPY_FLASHSIZE_4MB=y
CONFIG_PARTITION_TABLE_SINGLE_APP_LARGE=y
CONFIG_FREERTOS_HZ=1000
CONFIG_HTTPD_WS_SUPPORT=y
CONFIG_HTTPD_MAX_REQ_HDR_LEN=1024
CONFIG_ESP_MAIN_TASK_STACK_SIZE=8192
CONFIG_LWIP_MAX_SOCKETS=16
CONFIG_COMPILER_OPTIMIZATION_PERF=y
```
